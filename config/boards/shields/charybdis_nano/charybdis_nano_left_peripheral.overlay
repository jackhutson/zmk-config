/*
 * Copyright (c) 2026 The ZMK Contributors
 * SPDX-License-Identifier: MIT
 *
 * Charybdis Nano Left Half (Peripheral for Dongle Mode)
 * This variant is used when a dongle is central and both halves are peripherals.
 */

#include "charybdis_nano.dtsi"

/*
 * Column GPIO Configuration for Left Half
 * Columns C2-C6 directly wired to nice_nano pins.
 */
&kscan0 {
    col-gpios
        = <&gpio0 29 (GPIO_ACTIVE_HIGH | GPIO_PULL_DOWN)>  /* C2 = P0.29 (D20) -> col 0 */
        , <&gpio0  9 (GPIO_ACTIVE_HIGH | GPIO_PULL_DOWN)>  /* C3 = P0.09 (D10) -> col 1 */
        , <&gpio1  0 (GPIO_ACTIVE_HIGH | GPIO_PULL_DOWN)>  /* C4 = P1.00 (D6)  -> col 2 */
        , <&gpio1  4 (GPIO_ACTIVE_HIGH | GPIO_PULL_DOWN)>  /* DIAG: C6 pin on logical col 3 */
        , <&gpio0 11 (GPIO_ACTIVE_HIGH | GPIO_PULL_DOWN)>  /* DIAG: C5 pin on logical col 4 */
        ;
};

/*
 * Left peripheral has no local trackball device and should not expose
 * input-split/listener services; those are handled by right half and dongle.
 */
&trackball_split {
    status = "disabled";
};

&trackball_listener {
    status = "disabled";
};

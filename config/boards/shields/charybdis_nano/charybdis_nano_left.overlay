/*
 * Copyright (c) 2024 The ZMK Contributors
 * SPDX-License-Identifier: MIT
 *
 * Charybdis Nano Left Half (Central)
 * This is the central/master side that connects to the host via USB/BLE.
 */

#include "charybdis_nano.dtsi"

/*
 * Column GPIO Configuration for Left Half
 * Columns C2-C6 directly wired to nice_nano pins.
 *
 * Diode direction is row2col, so columns are inputs (with pull-down).
 */
&kscan0 {
    col-gpios
        = <&gpio0 29 (GPIO_ACTIVE_HIGH | GPIO_PULL_DOWN)>  /* C2 = P0.29 (D20) -> col 0 */
        , <&gpio0  9 (GPIO_ACTIVE_HIGH | GPIO_PULL_DOWN)>  /* C3 = P0.09 (D10) -> col 1 */
        , <&gpio1  0 (GPIO_ACTIVE_HIGH | GPIO_PULL_DOWN)>  /* C4 = P1.00 (D6)  -> col 2 */
        , <&gpio0 11 (GPIO_ACTIVE_HIGH | GPIO_PULL_DOWN)>  /* C5 = P0.11 (D7)  -> col 3 */
        , <&gpio1  4 (GPIO_ACTIVE_HIGH | GPIO_PULL_DOWN)>  /* C6 = P1.04 (D8)  -> col 4 */
        ;
};

/*
 * Enable trackball listener on central side.
 * This receives proxied events from the peripheral's trackball.
 */
&trackball_listener {
    status = "okay";
};

## config/boards/shields/charybdis_nano/Kconfig.defconfig
```kconfig
# Copyright (c) 2024 The ZMK Contributors
# SPDX-License-Identifier: MIT

if SHIELD_CHARYBDIS_NANO_LEFT

config ZMK_KEYBOARD_NAME
    default "Charybdis Nano"

config ZMK_SPLIT_ROLE_CENTRAL
    default y

endif # SHIELD_CHARYBDIS_NANO_LEFT

if SHIELD_CHARYBDIS_NANO_LEFT_PERIPHERAL

config ZMK_KEYBOARD_NAME
    default "Charybdis Nano"

config ZMK_SPLIT
    default y

config ZMK_SPLIT_ROLE_CENTRAL
    default n

config ZMK_POINTING
    default n

endif # SHIELD_CHARYBDIS_NANO_LEFT_PERIPHERAL

if SHIELD_CHARYBDIS_NANO_DONGLE

config ZMK_KEYBOARD_NAME
    default "Charybdis Nano Dongle"

config ZMK_SPLIT
    default y

config ZMK_SPLIT_ROLE_CENTRAL
    default y

config ZMK_SPLIT_BLE_CENTRAL_PERIPHERALS
    default 2

config BT_MAX_CONN
    default 6

config BT_MAX_PAIRED
    default 6

endif # SHIELD_CHARYBDIS_NANO_DONGLE

if SHIELD_CHARYBDIS_NANO_LEFT || SHIELD_CHARYBDIS_NANO_RIGHT

config ZMK_SPLIT
    default y

config ZMK_POINTING
    default y

endif # SHIELD_CHARYBDIS_NANO_LEFT || SHIELD_CHARYBDIS_NANO_RIGHT

if SHIELD_CHARYBDIS_NANO_RIGHT

config SPI
    default y

config INPUT
    default y

config PMW3610_ALT
    default y

endif # SHIELD_CHARYBDIS_NANO_RIGHT
```

## config/boards/shields/charybdis_nano/Kconfig.shield
```kconfig
# Copyright (c) 2024 The ZMK Contributors
# SPDX-License-Identifier: MIT

config SHIELD_CHARYBDIS_NANO_LEFT
    def_bool $(shields_list_contains,charybdis_nano_left)

config SHIELD_CHARYBDIS_NANO_RIGHT
    def_bool $(shields_list_contains,charybdis_nano_right)
```
